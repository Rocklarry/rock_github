/*
 * Spreadtrum SP9832E 1H10 GO FULL board DTS file
 *
 * Copyright (C) 2019-2020, Spreadtrum Communications Inc.
 *
 * This file is licensed under a dual GPLv2 or X11 license.
 */
/dts-v1/;

#include <dt-bindings/gpio/gpio.h>
#include "sc9832e.dtsi"
#include "sp9832e-go-mach.dtsi"
#include "sc9832e-wcn.dtsi"
#include "sc2721.dtsi"
#include "sprd-sound-sharkl.dtsi"
#include "lcd/lcd_ili9881c_truly_mipi_hd.dtsi"
#include "lcd/lcd_dummy_mipi.dtsi"

/ {
	model = "Spreadtrum SL8541E-1H10-32b Board";

	compatible = "sprd,sl8541e-1h10", "sprd,sc9832e";

	sprd,sc-id = <9832 3 0x20000>;

	aliases {
		serial1 = &uart1;
		serial0 = &uart0;
	};

	memory: memory@80000000 {
		device_type = "memory";
		reg = <0x80000000 0x40000000>;
	};

	chosen {
		stdout-path = &uart0;
		bootargs = "earlycon=sprd_serial,0x508d0000,115200n8
			console=ttyS0,115200n8 loglevel=0 init=/init root=/dev/ram0 rw
			androidboot.hardware=sl8541e_su806_v2 vmalloc=360M androidboot.dtbo_idx=0 printk.devkmsg=on androidboot.boot_devices=soc/soc:ap-ahb/20600000.sdio";
	};    //log level changed from 7 to 0 by ethan gao for mantis no.0049522:FT debug UART auto_test    //dump is suspected to be related to this code,so open selinux by yangjiakun mantis_num:0050990 2020-07-11

	ipi: interrupt-controller {
		compatible = "android,CustomIPI";
		#interrupt-cells = <1>;
		interrupt-controller;
	};

	trusty {
		compatible = "android,trusty-smc-v1";

		irq {
			compatible = "android,trusty-irq-v1";
			interrupt-templates = <&ipi 0>,
						<&gic 1 GIC_PPI 0>,
						<&gic 1 GIC_SPI 0>;
			interrupt-ranges = < 0  15 0>,
						<16  31 1>,
						<32 223 2>;
		};

		virtio {
			compatible = "android,trusty-virtio-v1";
		};

		log {
			compatible = "android,trusty-log-v1";
		};
	};
	/* WCN BASE mem adjust */
	wcn_btwf: cpwcn_btwf {
		sprd,ctrl-value = <0x00000000 0x0404 0x03000000
				   0x00080000 0x600 0x80>;
		reg = <0x84000000 0x180000>;
	};

	wcn_gnss: cpwcn_gnss {
		sprd,ctrl-value = <0x00300000 0x0404 0x03000000
				   0x00080000 0xa00 0x40>;
		reg = <0x84300000 0x100000>;
	};

	wcn_sipc {
		/delete-node/ sipc@88180000;
		/delete-node/ sipc@8841b000;
		sipc2: sipc@84180000 {
			sprd,name = "sipc-wcn";
			sprd,dst = <3 5>; /* <dst core-id> */
			/* <ap-addr dst-maped-addr size> */
			sprd,smem-info = <0x84180000 0x00180000 0x180000>;
		};

		sipc3: sipc@8441b000 {
			sprd,name = "sipc-gnss";
			sprd,dst = <4 6>; /* <dst core-id> */
			/* <ap-addr dst-maped-addr size> */
			sprd,smem-info = <0x8441b000 0x11b000 0x32000>;
		};
	};

	sprd-map-user {
		compatible = "sprd,map-user";
	};

	ion {
		compatible = "sprd,ion";
		#address-cells = <1>;
		#size-cells = <0>;

		heap@4 {
			reg = <4>;
			label = "carveout_fd";
			type = <2>;
			memory-region = <&fd_reserved>;
		};
	};

	tboard_thermistor:thermal-sensor {
		compatible = "generic-adc-thermal";
		#thermal-sensor-cells = <0>;
		io-channels = <&pmic_adc 3>;
		io-channel-names = "sensor-channel";
		temperature-lookup-table = <	(-39700) 1131
						(-29800) 1110
						(-19500) 1074
						(-4800) 983
						10100 838
						24800 654
						44900 413
						54900 316
						64900 238
						74900 178
						84900 133
						94900 100
						104900 75
						114900 57
						124900 43 >;
	};
	pa_thermistor:pa-sensor {
		compatible = "generic-adc-thermal";
		#thermal-sensor-cells = <0>;
		io-channels = <&pmic_adc 2>;
		io-channel-names = "sensor-channel";
		temperature-lookup-table = <	(-39700) 1131
						(-29800) 1110
						(-19500) 1074
						(-4800) 983
						10100 838
						24800 654
						44900 413
						54900 316
						64900 238
						74900 178
						84900 133
						94900 100
						104900 75
						114900 57
						124900 43 >;
	};
/*
	chg_thermistor:chg-sensor {
		compatible = "generic-adc-thermal";
		#thermal-sensor-cells = <0>;
		io-channels = <&pmic_adc 4>;
		io-channel-names = "sensor-channel";
		temperature-lookup-table = <	(-39700) 1131
						(-29800) 1110
						(-19500) 1074
						(-4800) 983
						10100 838
						24800 654
						44900 413
						54900 316
						64900 238
						74900 178
						84900 133
						94900 100
						104900 75
						114900 57
						124900 43 >;
	};
*/

	extcon_gpio: extcon-gpio {
		compatible = "linux,extcon-usb-gpio";
		vbus-gpio = <&pmic_eic 0 GPIO_ACTIVE_HIGH>;
		id-gpio = <&eic_debounce 4 0>;
	};

	bat: battery {
		compatible = "simple-battery";
		charge-full-design-microamp-hours = <4300000>;
		charge-term-current-microamp = <120000>;
		constant_charge_voltage_max_microvolt = <4280000>;
		factory-internal-resistance-micro-ohms = <115000>;
		voltage-min-design-microvolt = <3561000>;
		ocv-capacity-celsius = <(-20) 0 20 40 60>;
		ocv-capacity-table-0 = <4175000 100>, <4104000 95>, <4046000 90>,
					<3992000 85>, <3941000 80>, <3892000 75>,
					<3841000 70>, <3792000 65>, <3745000 60>,
					<3705000 55>, <3673000 50>, <3648000 45>,
					<3628000 40>, <3610000 35>, <3592000 30>,
					<3573000 25>, <3549000 20>, <3518000 15>,
					<3482000 10>, <3441000 5>, <3400000 0>;
		ocv-capacity-table-1 = <4175000 100>, <4104000 95>, <4046000 90>,
					<3992000 85>, <3941000 80>, <3892000 75>,
					<3841000 70>, <3792000 65>, <3745000 60>,
					<3705000 55>, <3673000 50>, <3648000 45>,
					<3628000 40>, <3610000 35>, <3592000 30>,
					<3573000 25>, <3549000 20>, <3518000 15>,
					<3482000 10>, <3441000 5>, <3400000 0>;
		ocv-capacity-table-2 = <4174000 100>, <4108000 95>, <4052000 90>,
					<3999000 85>, <3949000 80>, <3900000 75>,
					<3850000 70>, <3803000 65>, <3761000 60>,
					<3721000 55>, <3684000 50>, <3656000 45>,
					<3636000 40>, <3619000 35>, <3602000 30>,
					<3584000 25>, <3561000 20>, <3529000 15>,
					<3493000 10>, <3453000 5>, <3400000 0>;
		ocv-capacity-table-3 = <4173000 100>, <4109000 95>, <4053000 90>,
					<4001000 85>, <3951000 80>, <3903000 75>,
					<3856000 70>, <3810000 65>, <3768000 60>,
					<3729000 55>, <3690000 50>, <3662000 45>,
					<3641000 40>, <3624000 35>, <3607000 30>,
					<3586000 25>, <3559000 20>, <3527000 15>,
					<3492000 10>, <3454000 5>, <3400000 0>;
		ocv-capacity-table-4 = <4165000 100>, <4098000 95>, <4039000 90>,
					<3986000 85>, <3937000 80>, <3889000 75>,
					<3842000 70>, <3799000 65>, <3758000 60>,
					<3718000 55>, <3682000 50>, <3657000 45>,
					<3639000 40>, <3622000 35>, <3605000 30>,
					<3577000 25>, <3548000 20>, <3517000 15>,
					<3480000 10>, <3445000 5>, <3400000 0>;
		voltage-temp-table = <1215000 700>, <1199000 750>, <1155000 850>,
					<1046000 1000>, <942000 1100>, <748000 1250>,
					<547000 1400>, <426000 1500>, <283000 1650>,
					<212000 1750>;
		rint-temp-celsius = <(-20) 0 20 40 60>;
		rint-capacity-celsius = <100 95 90 85 80 75 70 65 60 55
					50 45 40 35 30 25 20 15 10 5 0>;
		rint-capacity-table = <365 145 124 124 143>,
					<543 197 141 136 150>,
					<574 207 143 138 152>,
					<567 209 145 140 158>,
					<557 212 148 142 162>,
					<547 214 152 144 165>,
					<537 212 154 145 167>,
					<528 207 155 147 170>,
					<520 200 157 149 172>,
					<514 194 156 150 170>,
					<509 191 149 144 164>,
					<504 192 146 141 163>,
					<503 195 146 142 165>,
					<507 200 147 143 168>,
					<513 206 149 146 171>,
					<523 214 152 146 166>,
					<538 224 152 143 165>,
					<558 239 151 144 167>,
					<588 278 153 146 169>,
					<632 460 163 149 174>,
					<689 609 211 162 207>;
		charge-sdp-current-microamp = <450000 450000>;
		charge-dcp-current-microamp = <700000 700000>;
		charge-cdp-current-microamp = <700000 700000>;
		charge-unknown-current-microamp = <450000 450000>;
		capacity-temp-table = <60 100>, <40 100>, <25 100>, <0 100>, <(-10) 80>;
		resistance-temp-table = <60 60>, <40 70>, <25 100>, <0 328>, <(-20) 887>;
	};

	charger-manager {
		compatible = "charger-manager";
		cm-name = "battery";
		cm-poll-mode = <2>;
		cm-poll-interval = <15000>;
		cm-battery-stat = <2>;

		cm-fullbatt-vchkdrop-ms = <30000>;
		cm-fullbatt-vchkdrop-volt = <84000>;
		cm-fullbatt-voltage = <4184000>;
		cm-fullbatt-current = <120000>;
		cm-fullbatt-capacity = <100>;

		cm-num-chargers = <1>;
		cm-chargers = "sc2721_charger";
		cm-fuel-gauge = "sc27xx-fgu";

		/* in deci centigrade */
		cm-battery-cold = <200>;
		cm-battery-cold-in-minus;
		cm-battery-hot = <800>;
		cm-battery-temp-diff = <100>;

		/* Allow charging for 6hr */
		cm-charging-max = <36000000>;
		/* recovery charging after stop charging 45min */
		cm-discharging-max = <2700000>;

		/* the interval to feed charger watchdog */
		cm-wdt-interval = <0>;

		/* drop voltage in microVolts to allow shutdown */
		cm-shutdown-voltage = <3050000>;

		/* when 99% of the time is exceeded, it will be forced to 100% */
		cm-tickle-time-out = <1500>;

		/* how much time to allow capacity change */
		cm-one-cap-time = <60>;

		/* when the safe charging voltage is exceeded, stop charging */
		cm-charge-voltage-max = <6500000>;
		/* drop voltage in microVolts to restart charging */
		cm-charge-voltage-drop = <700000>;
		cm-jeita-temp-table = <1000 1030 0 4200000>,
				<1150 1180 700000 4200000>,
				<1450 1420 1150000 4200000>,
				<1600 1570 700000 4150000>;

		regulator@0 {
			cm-regulator-name = "vddgen0";
			cable@0 {
				cm-cable-name = "USB";
				extcon = <&extcon_gpio>;
			};
		};
	};

	sprd-wlan {
		 compatible = "sprd,sp9832e";
	};
	sgm3141b: sgm3141b{
		compatible = "sprd,flash-sgm3141b";
		flash-ic = <3141>;
		flash-torch-en-gpios = <&ap_gpio 134 0>;
		flash-en-gpios = <&ap_gpio 10 0>;
	};
};

&reserved_memory {
	tos_reserved: tos-mem@94020000 {
		reg = <0x94020000 0x01fe0000>;
	};

	fd_reserved: fd-mem@bfa80000 {
		reg = <0xbfa80000 0x00500000>;
	};
};

&uart1 {
	status = "okay";
};

&uart0 {
	status = "okay";
};

&power {
	sprd,cm4-uart;
};

&hsphy {
	vdd-supply = <&vddusb33>;
	extcon = <&extcon_gpio>;
};

&usb {
	extcon = <&extcon_gpio>, <&extcon_gpio>, <&pmic_typec>;
	vbus-supply = <&vddvbus>;
	sprd,otg-gpios = <&ap_gpio 133 1>;
};

&thm_zone {
	bd_thmzone: board-thmzone {
		polling-delay-passive = <0>;
		polling-delay = <0>;
		thermal-sensors = <&tboard_thermistor>;
	};

	pa_thmzone: pa-thmzone {
		polling-delay-passive = <0>;
		polling-delay = <0>;
		thermal-sensors = <&pa_thermistor>;
	};

/*
	chg_thmzone: chg-thmzone {
		polling-delay-passive = <0>;
		polling-delay = <0>;
		thermal-sensors = <&chg_thermistor>;
	};
*/
};

&dpu {
	status = "okay";
};

&jpg {
	status = "okay";
};

&iommu_jpg {
	status = "okay";
};

&vsp {
	status = "okay";
};

&iommu_vsp {
	status = "okay";
};

&iommu_dispc {
	status = "okay";
};

&dsi {
	status = "okay";
	#address-cells = <1>;
	#size-cells = <0>;

	panel: panel {
		compatible = "sprd,generic-mipi-panel";
		#address-cells = <1>;
		#size-cells = <0>;
		reg = <0>;

		reset-gpio = <&ap_gpio 50 GPIO_ACTIVE_HIGH>;
		port {
			reg = <1>;
			panel_in: endpoint {
				remote-endpoint = <&dphy_out>;
			};
		};
	};
};

&dphy {
	status = "okay";
};

&sdio0 {
	cd-gpios= <&ap_gpio 78 1>;
};

&spi0 {
	/*used for fingerprint sensor*/
	status = "okay";
};
/*fibo_changll: modify mantis0060786 ldo supply issue 2020-10-27 start */
&i2c0 {
	status = "okay";
	clock-frequency = <400000>;

	sensor_main: sensor-main@20 { //imx258 back main
		compatible = "sprd,sensor-main";
		reg = <0x20>;
		clock-names = "clk_src","sensor_eb",
			"clk_96m","clk_76m8",
			"clk_48m","clk_26m";
		clocks = <&mm_clk CLK_SENSOR0>, <&mm_gate CLK_SENSOR0_EB>,
			<&pll CLK_TWPLL_96M>,<&pll CLK_TWPLL_76M8>,
			<&pll CLK_TWPLL_48M>,<&ext_26m>;
		vddio-supply = <&vddcamio>;
		vddcama-supply = <&vddcammot>;
		vddcamd-supply = <&vddcamd>;
		vddcammot-supply = <&vdd28>;
		sprd,phyid = <1>;
		csi = <&csi0>;
		reset-gpios = <&ap_gpio 44 0>;
		power-down-gpios = <&ap_gpio 46 0>;
	};
};

&i2c1 {
	status = "okay";
	clock-frequency = <400000>;

	sensor_sub: sensor-sub@20 {
		compatible = "sprd,sensor-sub";
		reg = <0x20>;
		clock-names = "clk_src","sensor_eb",
				"clk_96m","clk_76m8",
				"clk_48m","clk_26m";
		clocks = <&mm_clk CLK_SENSOR1>, <&mm_gate CLK_SENSOR1_EB>,
			<&pll CLK_TWPLL_96M>,<&pll CLK_TWPLL_76M8>,
			<&pll CLK_TWPLL_48M>,<&ext_26m>;
		vddcama-supply = <&vddcammot>;
		sprd,phyid = <3>;
		csi = <&csi1>;
		reset-gpios = <&ap_gpio 45 0>;
		power-down-gpios = <&ap_gpio 47 0>;
		dvdd-gpios = <&ap_gpio 32 0>;
	};

	sensor_main2: sensor-main2@6C {
		compatible = "sprd,sensor-main2";
		reg = <0x6C>;
		clock-names = "clk_src","sensor_eb",
				"clk_96m","clk_76m8",
				"clk_48m","clk_26m";
		clocks = <&mm_clk CLK_SENSOR1>, <&mm_gate CLK_SENSOR1_EB>,
			<&pll CLK_TWPLL_96M>,<&pll CLK_TWPLL_76M8>,
			<&pll CLK_TWPLL_48M>,<&ext_26m>;
		vddcama-supply = <&vddcammot>;
		vddcammot-supply = <&vdd28>;
		sprd,phyid = <2>;
		csi = <&csi1>;
		reset-gpios = <&ap_gpio 41 0>;
		power-down-gpios = <&ap_gpio 40 0>;
		dvdd-gpios = <&ap_gpio 32 0>;
	};
};
/*fibo_changll: modify mantis0060786 ldo supply issue 2020-10-27 end */
&i2c4 {
	status = "okay";
	clock-frequency = <400000>;

	flash_ic: flash-ic@63 {
		compatible = "sprd,flash-ocp8137";
		reg = <0x63>;
		sprd,flash-ic = <8137>;
		sprd,torch = <1>;
		sprd,preflash = <1>;
		sprd,highlight = <1>;
		sprd,torch-level = <128>;
		sprd,preflash-level = <128>;
		sprd,highlight-level = <128>;
		sprd,lvfm-enable = <1>;
		flash-torch-en-gpios = <&ap_gpio 88 0>;
		flash-chip-en-gpios = <&ap_gpio 89 0>;
		flash-en-gpios = <&ap_gpio 76 0>;
		flash-sync-gpios = <&ap_gpio 141 0>;
	};

	fan54015_chg: charger@6a {
		compatible = "fairchild,fan54015_chg";
		reg = <0x6a>;
		phys = <&hsphy>;
		monitored-battery = <&bat>;
		extcon = <&extcon_gpio>;
		vddvbus:otg-vbus {
			regulator-name = "vddvbus";
		};
	};
};

&pmic_fgu {
	monitored-battery = <&bat>;
	sprd,calib-resistance-real = <12200>;
	sprd,calib-resistance-spec = <20000>;
};

&pmic_charger {
	status = "okay";
	phys = <&hsphy>;
	monitored-battery = <&bat>;
};

&i2s0 {
	status = "okay";
};

&sprd_audio_codec_ana {
	status = "okay";
	digital-codec = <&sprd_audio_codec_dig>;
};

&sprd_headset {
	status = "okay";
};

&sound_vbc_r1p0v3_sprd_codec {
	status = "okay";
	sprd,smartamp-boost-names = "boost_enable", "boost_mode";
	sprd,smartamp-boost-gpios = <&ap_gpio 121 0>,
				<&ap_gpio 85 0>;
};

&sound_sprd_ap_alliis {
	status = "okay";
};

&pwms {
	status = "okay";
};

&iommu_dcam {
	status = "okay";
};

&iommu_isp {
	status = "okay";
};

&iommu_cpp {
	status = "okay";
};

&dcam {
	status = "okay";
};

&isp {
	status = "okay";
};

&cpp {
	status = "okay";
};

&csi0 {
	status = "okay";
};

&csi1 {
	status = "okay";
};

&cpu0 {
	cpu-supply = <&vddcpu>;
};

&cpu1 {
	cpu-supply = <&vddcpu>;
};

&cpu2 {
	cpu-supply = <&vddcpu>;
};

&cpu3 {
	cpu-supply = <&vddcpu>;
};


&vddrf18 {
	status = "disabled";
};

&vddrf125 {
	status = "disabled";
};

&vddsim2 {
	status = "disabled";
};

&vddldomem {
	status = "disabled";
};

&pin_controller {
	pinctrl-names =
	/* keyout0 ~ keyout2 */
	"gpio_121", "gpio_122", "gpio_123",
	/* keyin0 ~ keyin2 */
	"gpio_124", "gpio_125", "gpio_126",
	/* extint0, extint1, scl3, sda3 */
	"gpio_144", "gpio_145", "gpio_146", "gpio_147",
	/* for FT GPIO test */
	"gpio_86", "gpio_87", "gpio_9", "gpio_162", "gpio_160", "gpio_161",
	"gpio_31", "gpio_159", "gpio_157", "gpio_158", "gpio_143", "gpio_76",
	"gpio_141", "gpio_60", 
	"gpio_61", "gpio_62", "gpio_63", "gpio_50", "gpio_51", "gpio_44", "gpio_46",
	"gpio_45", "gpio_47", "gpio_48", "gpio_49", "gpio_32", "gpio_127", "gpio_128",
	"gpio_71", "gpio_70", "gpio_132", "gpio_133", "gpio_131", "gpio_130",
	"gpio_26", "gpio_33", "gpio_22", "gpio_23", "gpio_27", "gpio_28", "gpio_52","gpio_53",
	"gpio_54", "gpio_55", "gpio_29", "gpio_30", "gpio_7", "gpio_93", "gpio_90", "gpio_92",
	"gpio_91", "gpio_155", "gpio_154", "gpio_147", "gpio_74", "gpio_73", "gpio_75", "gpio_72",
	"gpio_4", "gpio_10", "gpio_41", "gpio_40", "gpio_5", "gpio_24", "gpio_25", "gpio_156", "gpio_42", "gpio_43", "gpio_11",
	/* add new for su806 Android10 FT test 2020-8-21 */
	"gpio_129", "gpio_134", "gpio_139", "gpio_135", "gpio_136", "gpio_137", "gpio_140", "gpio_138", "gpio_89", "gpio_88", "gpio_85";
	
	pinctrl-0 = <&gpio_121>;
	pinctrl-1 = <&gpio_122>;
	pinctrl-2 = <&gpio_123>;
	pinctrl-3 = <&gpio_124>;
	pinctrl-4 = <&gpio_125>;
	pinctrl-5 = <&gpio_126>;
	pinctrl-6 = <&gpio_144>;
	pinctrl-7 = <&gpio_145>;
	pinctrl-8 = <&gpio_146>;
	pinctrl-9 = <&gpio_147>;
	pinctrl-10 = <&gpio_86>;
	pinctrl-11 = <&gpio_87>;
	pinctrl-12 = <&gpio_9>;
	pinctrl-13 = <&gpio_162>;
	pinctrl-14 = <&gpio_160>;
	pinctrl-15 = <&gpio_161>;
	pinctrl-16 = <&gpio_31>;
	pinctrl-17 = <&gpio_159>;
	pinctrl-18 = <&gpio_157>;
	pinctrl-19 = <&gpio_158>;
	pinctrl-20 = <&gpio_143>;
	pinctrl-21 = <&gpio_76>;
	pinctrl-22 = <&gpio_141>;
	pinctrl-23 = <&gpio_60>;
	pinctrl-24 = <&gpio_61>;
	pinctrl-25 = <&gpio_62>;
	pinctrl-26 = <&gpio_63>;
	pinctrl-27 = <&gpio_50>;
	pinctrl-28 = <&gpio_51>;
	pinctrl-29 = <&gpio_44>;
	pinctrl-30 = <&gpio_46>;
	pinctrl-31 = <&gpio_45>;
	pinctrl-32 = <&gpio_47>;
	pinctrl-33 = <&gpio_48>;
	pinctrl-34 = <&gpio_49>;
	pinctrl-35 = <&gpio_32>;
	pinctrl-36 = <&gpio_127>;
	pinctrl-37 = <&gpio_128>;
	pinctrl-38 = <&gpio_71>;
	pinctrl-39 = <&gpio_70>;
	pinctrl-40 = <&gpio_132>;
	pinctrl-41 = <&gpio_133>;
	pinctrl-42 = <&gpio_131>;
	pinctrl-43 = <&gpio_130>;
	pinctrl-44 = <&gpio_26>;
	pinctrl-45 = <&gpio_33>;
	pinctrl-46 = <&gpio_22>;
	pinctrl-47 = <&gpio_23>;
	pinctrl-48 = <&gpio_27>;
	pinctrl-49 = <&gpio_28>;
	pinctrl-50 = <&gpio_52>;
	pinctrl-51 = <&gpio_53>;
	pinctrl-52 = <&gpio_54>;
	pinctrl-53 = <&gpio_55>;
	pinctrl-54 = <&gpio_29>;
	pinctrl-55 = <&gpio_30>;
	pinctrl-56 = <&gpio_7>;
	pinctrl-57 = <&gpio_93>;
	pinctrl-58 = <&gpio_90>;
	pinctrl-59 = <&gpio_92>;
	pinctrl-60 = <&gpio_91>;
	pinctrl-61 = <&gpio_155>;
	pinctrl-62 = <&gpio_154>;
	pinctrl-63 = <&gpio_147>;
	pinctrl-64 = <&gpio_74>;
	pinctrl-65 = <&gpio_73>;
	pinctrl-66 = <&gpio_75>;
	pinctrl-67 = <&gpio_72>;
	pinctrl-68 = <&gpio_4>;
	pinctrl-69 = <&gpio_10>;
	pinctrl-70 = <&gpio_41>;
	pinctrl-71 = <&gpio_40>;
	pinctrl-72 = <&gpio_5>;
	pinctrl-73 = <&gpio_24>;
	pinctrl-74 = <&gpio_25>;
	/*2020-6-2 add by yangjiakun for ft allpin test*/
	pinctrl-75 = <&gpio_156>;
	/*2020-6-11 add by yangjiakun for ft ADC test*/
	pinctrl-76 = <&gpio_42>;
	pinctrl-77 = <&gpio_43>;
	/* add new for su806 Android10 FT test 2020-8-21 */
	pinctrl-78 = <&gpio_11>;
	pinctrl-79 = <&gpio_129>;
	pinctrl-80 = <&gpio_134>;
	pinctrl-81 = <&gpio_139>;
	pinctrl-82 = <&gpio_135>;
	pinctrl-83 = <&gpio_136>;
	pinctrl-84 = <&gpio_137>;
	pinctrl-85 = <&gpio_140>;
	pinctrl-86 = <&gpio_138>;
	pinctrl-87 = <&gpio_89>;
	pinctrl-88 = <&gpio_88>;
	pinctrl-89 = <&gpio_85>;
	
	gpio_121: keyout0 {
		pins = "SHARKLE_KEYOUT0";
		function = "func4";
	};

	gpio_122: keyout1 {
		pins = "SHARKLE_KEYOUT1";
		function = "func4";
	};

	gpio_123: keyout2 {
		pins = "SHARKLE_KEYOUT2";
		function = "func4";
	};

	gpio_124: keyin0 {
		pins = "SHARKLE_KEYIN0";
		function = "func4";
	};

	gpio_125: keyin1 {
		pins = "SHARKLE_KEYIN1";
		function = "func4";
	};

	gpio_126: keyin2 {
		pins = "SHARKLE_KEYIN2";
		function = "func4";
	};

	gpio_144: extint0 {
		pins = "SHARKLE_EXTINT0";
		function = "func4";
	};

	gpio_145: extint1 {
		pins = "SHARKLE_EXTINT1";
		function = "func4";
	};

	gpio_146: scl3 {
		pins = "SHARKLE_SCL3";
		function = "func4";
	};

	gpio_147: sda3 {
		pins = "SHARKLE_SDA3";
		function = "func4";
	};
	gpio_86: tdi_lte {
		pins = "SHARKLE_TDI_LTE";
		function = "func4";
	};
	gpio_87: tck_lte {
		pins = "SHARKLE_TCK_LTE";
		function = "func4";
	};
	gpio_9: gpio9 {
		pins = "SHARKLE_GPIO9";
		function = "func4";
	};
	gpio_162: simrst1 {
		pins = "SHARKLE_SIMRST1";
		function = "func4";
	};
	gpio_160: simclk1 {
		pins = "SHARKLE_SIMCLK1";
		function = "func4";
	};
	gpio_161: simdat1 {
		pins = "SHARKLE_SIMDAT1";
		function = "func4";
	};
	gpio_31: gpio31 {
		pins = "SHARKLE_GPIO31";
		function = "func4";
	};
	gpio_159: simrst0 {
		pins = "SHARKLE_SIMRST0";
		function = "func4";
	};
	gpio_157: SIMclk0 {
		pins = "SHARKLE_SIMCLK0";
		function = "func4";
	};
	gpio_158: simdat0 {
		pins = "SHARKLE_SIMDAT0";
		function = "func4";
	};
	gpio_143: nf_data_2 {
		pins = "SHARKLE_NF_DATA_2";
		function = "func4";
	};
	gpio_76: nf_data_1 {
		pins = "SHARKLE_NF_DATA_1";
		function = "func4";
	};
	gpio_141: nf_data_0 {
		pins = "SHARKLE_NF_DATA_0";
		function = "func4";
	};
	gpio_60: u0txd {
		pins = "SHARKLE_U0TXD";
		function = "func4";
	};
	gpio_61: u0rxd {
		pins = "SHARKLE_U0RXD";
		function = "func4";
	};
	gpio_62: u0cts {
		pins = "SHARKLE_U0CTS";
		function = "func4";
	};
	gpio_63: u0rts {
		pins = "SHARKLE_U0RTS";
		function = "func4";
	};
	gpio_50: lcm_rstn {
		pins = "SHARKLE_LCM_RSTN";
		function = "func4";
	};
	gpio_51: lcm_fmark {
		pins = "SHARKLE_LCM_FMARK";
		function = "func4";
	};
	gpio_44: cmrst0 {
		pins = "SHARKLE_CMRST0";
		function = "func4";
	};
	gpio_46: cmpd0 {
		pins = "SHARKLE_CMPD0";
		function = "func4";
	};
	gpio_45: cmrst1 {
		pins = "SHARKLE_CMRST1";
		function = "func4";
	};
	gpio_47: cmpd1 {
		pins = "SHARKLE_CMPD1";
		function = "func4";
	};
	gpio_48: scl0 {
		pins = "SHARKLE_SCL0";
		function = "func4";
	};
	gpio_49: sda0 {
		pins = "SHARKLE_SDA0";
		function = "func4";
	};
	gpio_32: gpio32 {
		pins = "SHARKLE_GPIO32";
		function = "func4";
	};
	gpio_127: scl2 {
		pins = "SHARKLE_SCL2";
		function = "func4";
	};
	gpio_128: sda2 {
		pins = "SHARKLE_SDA2";
		function = "func4";
	};
	gpio_71: u1rxd {
		pins = "SHARKLE_U1RXD";
		function = "func4";
	};
	gpio_70: u1txd {
		pins = "SHARKLE_U1TXD";
		function = "func4";
	};
	gpio_132: iis1clk {
		pins = "SHARKLE_IIS1CLK";
		function = "func4";
	};
	gpio_133: iis1lrck {
		pins = "SHARKLE_IIS1LRCK";
		function = "func4";
	};
	gpio_131: iis1do {
		pins = "SHARKLE_IIS1DO";
		function = "func4";
	};
	gpio_130: iis1di {
		pins = "SHARKLE_IIS1DI";
		function = "func4";
	};
	gpio_26: rfctl7 {
		pins = "SHARKLE_RFCTL7";
		function = "func4";
	};
	gpio_33: gpio33 {
		pins = "SHARKLE_GPIO33";
		function = "func4";
	};
	gpio_22: rfctl3 {
		pins = "SHARKLE_RFCTL3";
		function = "func4";
	};
	gpio_23: rfctl4 {
		pins = "SHARKLE_RFCTL4";
		function = "func4";
	};
	gpio_27: rfctl8 {
		pins = "SHARKLE_RFCTL8";
		function = "func4";
	};
	gpio_28: rfctl9 {
		pins = "SHARKLE_RFCTL9";
		function = "func4";
	};
	gpio_52: spi2_csn {
		pins = "SHARKLE_SPI2_CSN";
		function = "func4";
	};
	gpio_53: spi2_do {
		pins = "SHARKLE_SPI2_DO";
		function = "func4";
	};
	gpio_54: spi2_di {
		pins = "SHARKLE_SPI2_DI";
		function = "func4";
	};
	gpio_55: spi2_clk {
		pins = "SHARKLE_SPI2_CLK";
		function = "func4";
	};
	gpio_29: rfctl10 {
		pins = "SHARKLE_RFCTL10";
		function = "func4";
	};
	gpio_30: rfctl11 {
		pins = "SHARKLE_RFCTL11";
		function = "func4";
	};
	gpio_7: rfctl16 {
		pins = "SHARKLE_RFCTL16";
		function = "func4";
	};
	gpio_93: spi0_clk {
		pins = "SHARKLE_SPI0_CLK";
		function = "func4";
	};
	gpio_90: spi0_csn {
		pins = "SHARKLE_SPI0_CSN";
		function = "func4";
	};
	gpio_92: spi0_di {
		pins = "SHARKLE_SPI0_DI";
		function = "func4";
	};
	gpio_91: spi0_do {
		pins = "SHARKLE_SPI0_DO";
		function = "func4";
	};
	gpio_155: simdat2 {
		pins = "SHARKLE_SIMDAT2";
		function = "func4";
	};
	gpio_154: simclk2 {
		pins = "SHARKLE_SIMCLK2";
		function = "func4";
	};
	gpio_147: sda3 {
		pins = "SHARKLE_SDA3";
		function = "func4";
	};
	gpio_74: scl1 {
		pins = "SHARKLE_SCL1";
		function = "func4";
	};
	gpio_73: u2rxd {
		pins = "SHARKLE_U2RXD";
		function = "func4";
	};
	gpio_75: sda1 {
		pins = "SHARKLE_SDA1";
		function = "func4";
	};
	gpio_72: u2txd {
		pins = "SHARKLE_U2TXD";
		function = "func4";
	};
	gpio_4: lvdsrf0_adcon {
		pins = "SHARKLE_LVDSRF0_ADCON";
		function = "func4";
	};
	gpio_10: rfctl9 {
		pins = "SHARKLE_RFCTL19";
		function = "func4";
	};
	gpio_41: cmrst2 {
		pins = "SHARKLE_CMRST2";
		function = "func4";
	};
	gpio_40: cmpd2 {
		pins = "SHARKLE_CMPD2";
		function = "func4";
	};
	gpio_5: lvdsrf0_dacon {
		pins = "SHARKLE_LVDSRF0_DACON";
		function = "func4";
	};
	gpio_24: rfctl5 {
		pins = "SHARKLE_RFCTL5";
		function = "func4";
	};
	gpio_25: rfctl6 {
		pins = "SHARKLE_RFCTL6";
		function = "func4";
	};
	/*2020-6-2 add by yangjiakun for ft allpin test*/
	gpio_156: simrst2 {
		pins = "SHARKLE_SIMRST2";
		function = "func4";
	};
	/*2020-6-11 add by yangjiakun for ft ADC test*/
	gpio_42: cmmclk0 {
		pins = "SHARKLE_CMMCLK0";
		function = "func4";
	};
	gpio_43: cmmclk1 {
		pins = "SHARKLE_CMMCLK1";
		function = "func4";
	};
	/* add new for su806 Android10 FT test 2020-8-21 */
	gpio_11: rfctl20 {
		pins = "SHARKLE_RFCTL20";
		function = "func4";
	};
	gpio_129: clk_aux0 {
		pins = "SHARKLE_CLK_AUX0";
		function = "func4";
	};
	gpio_134: sd2_clk {
		pins = "SHARKLE_SD2_CLK";
		function = "func4";
	};
	gpio_139: sd2_d3 {
		pins = "SHARKLE_SD2_D3";
		function = "func4";
	};
	gpio_135: sd2_cmd {
		pins = "SHARKLE_SD2_CMD";
		function = "func4";
	};
	gpio_136: sd2_d0 {
		pins = "SHARKLE_SD2_D0";
		function = "func4";
	};
	gpio_137: sd2_d1 {
		pins = "SHARKLE_SD2_D1";
		function = "func4";
	};
	gpio_140: nf_cen0 {
		pins = "SHARKLE_NF_CEN0";
		function = "func4";
	};
	gpio_138: sd2_d2 {
		pins = "SHARKLE_SD2_D2";
		function = "func4";
	};
	gpio_89: rtck_lte {
		pins = "SHARKLE_RTCK_LTE";
		function = "func4";
	};
	gpio_88: tms_lte {
		pins = "SHARKLE_TMS_LTE";
		function = "func4";
	};
	gpio_85: tdo_lte {
		pins = "SHARKLE_TDO_LTE";
		function = "func4";
	};
};

/* Copyright (c) 2015-2016, The Linux Foundation. All rights reserved.
 *
 * This program is free software; you can redistribute it and/or modify
 * it under the terms of the GNU General Public License version 2 and
 * only version 2 as published by the Free Software Foundation.
 *
 * This program is distributed in the hope that it will be useful,
 * but WITHOUT ANY WARRANTY; without even the implied warranty of
 * MERCHANTABILITY or FITNESS FOR A PARTICULAR PURPOSE.  See the
 * GNU General Public License for more details.
 */
&mdss_mdp {
        dsi_ili_1080_vid: qcom,mdss_dsi_ili_1080p_video {
    qcom,mdss-dsi-panel-name = "ili 1080p video mode dsi panel riLCD-bl";
    qcom,mdss-dsi-panel-controller = <&mdss_dsi0>;
		qcom,mdss-dsi-panel-type = "dsi_video_mode";
		qcom,mdss-dsi-panel-framerate = <59>;
		qcom,mdss-dsi-virtual-channel-id = <0>;
		qcom,mdss-dsi-stream = <0>;
	  qcom,mdss-dsi-panel-width = <1080>;
		qcom,mdss-dsi-panel-height = <1920>;
		qcom,mdss-dsi-h-front-porch = <92>;
		qcom,mdss-dsi-h-back-porch = <68>;
		qcom,mdss-dsi-h-pulse-width = <20>;
		qcom,mdss-dsi-h-sync-skew = <0>;
		qcom,mdss-dsi-v-back-porch = <4>;
		qcom,mdss-dsi-v-front-porch = <4>;
		qcom,mdss-dsi-v-pulse-width = <4>;
		qcom,mdss-dsi-h-left-border = <0>;
		qcom,mdss-dsi-h-right-border = <0>;
		qcom,mdss-dsi-v-top-border = <0>;
		qcom,mdss-dsi-v-bottom-border = <0>; 
		qcom,mdss-dsi-bpp = <24>;
		qcom,mdss-dsi-underflow-color = <0xff>;
		qcom,mdss-dsi-border-color = <0>;
		qcom,mdss-dsi-h-sync-pulse = <0>;
		qcom,mdss-dsi-traffic-mode = "burst_mode";
		qcom,mdss-dsi-bllp-eof-power-mode;
		qcom,mdss-dsi-bllp-power-mode;
		qcom,mdss-dsi-lane-0-state;
		qcom,mdss-dsi-lane-1-state;
		qcom,mdss-dsi-lane-2-state;
		qcom,mdss-dsi-lane-3-state;
    qcom,mdss-dsi-panel-timings = [E6 38 26 00 68 6e 2A 3c 44 03 04 00];
                qcom,mdss-dsi-t-clk-post = <14>;
                qcom,mdss-dsi-t-clk-pre = <50>;
 

		qcom,mdss-dsi-bl-min-level = <1>;
	        qcom,mdss-dsi-bl-max-level = <4095>;

		qcom,mdss-dsi-dma-trigger = "trigger_sw";
		qcom,mdss-dsi-mdp-trigger = "none";
 
 qcom,mdss-dsi-on-command = [
39 01 00 00 00 00 04     FF   78  07 01	 
39 01 00 00 00 00 02     42   11	                     
39 01 00 00 00 00 02     43   A3	                     
39 01 00 00 00 00 02     44   A8	                     
39 01 00 00 00 00 02     45   19	                     
39 01 00 00 00 00 02     46   28	                     
39 01 00 00 00 00 02     4A   12	                     
39 01 00 00 00 00 02     4B   12	                     
39 01 00 00 00 00 02     50   5F	                     
39 01 00 00 00 00 02     51   5F	                     
39 01 00 00 00 00 02     B3   70	                     
39 01 00 00 00 00 02     B4   70	                     
39 01 00 00 00 00 02     A2   01	                     
39 01 00 00 00 00 02     A3   16	                     
39 01 00 00 00 00 04     FF   78 07 01	 
39 01 00 00 00 00 02     22   06	               
39 01 00 00 00 00 02     36   00                 
39 01 00 00 00 00 02     63   04                 
39 01 00 00 00 00 02     64   08                 
39 01 00 00 00 00 02     6C   45	               
39 01 00 00 00 00 02     6D   00	               
39 01 00 00 00 00 02     5A   33	               
39 01 00 00 00 00 04     FF   78  07 06	 
39 01 00 00 00 00 02     00   43           
39 01 00 00 00 00 02     01   12           
39 01 00 00 00 00 02     02   43           
39 01 00 00 00 00 02     03   43           
39 01 00 00 00 00 02     04   03           
39 01 00 00 00 00 02     05   12           
39 01 00 00 00 00 02     06   08           
39 01 00 00 00 00 02     07   0A           
39 01 00 00 00 00 02     08   83           
39 01 00 00 00 00 02     09   02           
39 01 00 00 00 00 02     0A   30           
39 01 00 00 00 00 02     0B   10           
39 01 00 00 00 00 02     0C   08           
39 01 00 00 00 00 02     0D   08           
39 01 00 00 00 00 02     0E   00           
39 01 00 00 00 00 02     0F   00           
39 01 00 00 00 00 02     10   00
39 01 00 00 00 00 02     11   00
39 01 00 00 00 00 02     12   00
39 01 00 00 00 00 02     13   00
39 01 00 00 00 00 02     14   84                          
39 01 00 00 00 00 02     15   84                          
39 01 00 00 00 00 02     31   08                          
39 01 00 00 00 00 02     32   01                          
39 01 00 00 00 00 02     33   00                          
39 01 00 00 00 00 02     34   11                          
39 01 00 00 00 00 02     35   13                          
39 01 00 00 00 00 02     36   26                          
39 01 00 00 00 00 02     37   22                           
39 01 00 00 00 00 02     38   02                          
39 01 00 00 00 00 02     39   0C                          
39 01 00 00 00 00 02     3A   02                          
39 01 00 00 00 00 02     3B   02                          
39 01 00 00 00 00 02     3C   02                          
39 01 00 00 00 00 02     3D   02                          
39 01 00 00 00 00 02     3E   28                          
39 01 00 00 00 00 02     3F   29                          
39 01 00 00 00 00 02     40   2A                          
39 01 00 00 00 00 02     41   08                          
39 01 00 00 00 00 02     42   01                          
39 01 00 00 00 00 02     43   00                          
39 01 00 00 00 00 02     44   10                          
39 01 00 00 00 00 02     45   12                          
39 01 00 00 00 00 02     46   26                          
39 01 00 00 00 00 02     47   22                         
39 01 00 00 00 00 02     48   02                          
39 01 00 00 00 00 02     49   0C                          
39 01 00 00 00 00 02     4A   02                          
39 01 00 00 00 00 02     4B   02                          
39 01 00 00 00 00 02     4C   02                          
39 01 00 00 00 00 02     4D   02                          
39 01 00 00 00 00 02     4E   28                          
39 01 00 00 00 00 02     4F   29                          
39 01 00 00 00 00 02     50   2A                          
39 01 00 00 00 00 02     61   0C                          
39 01 00 00 00 00 02     62   01                          
39 01 00 00 00 00 02     63   00                          
39 01 00 00 00 00 02     64   12                          
39 01 00 00 00 00 02     65   10                          
39 01 00 00 00 00 02     66   26                          
39 01 00 00 00 00 02     67   22                        
39 01 00 00 00 00 02     68   02                          
39 01 00 00 00 00 02     69   08                          
39 01 00 00 00 00 02     6A   02                          
39 01 00 00 00 00 02     6B   02                          
39 01 00 00 00 00 02     6C   02                          
39 01 00 00 00 00 02     6D   02                          
39 01 00 00 00 00 02     6E   28                          
39 01 00 00 00 00 02     6F   29                          
39 01 00 00 00 00 02     70   2A                          
39 01 00 00 00 00 02     71   0C                          
39 01 00 00 00 00 02     72   01                          
39 01 00 00 00 00 02     73   00                          
39 01 00 00 00 00 02     74   13                          
39 01 00 00 00 00 02     75   11                          
39 01 00 00 00 00 02     76   26                          
39 01 00 00 00 00 02     77   22                        
39 01 00 00 00 00 02     78   02                          
39 01 00 00 00 00 02     79   08                          
39 01 00 00 00 00 02     7A   02                          
39 01 00 00 00 00 02     7B   02                          
39 01 00 00 00 00 02     7C   02                          
39 01 00 00 00 00 02     7D   02                          
39 01 00 00 00 00 02     7E   28                          
39 01 00 00 00 00 02     7F   29                          
39 01 00 00 00 00 02     80   2A                          
39 01 00 00 00 00 02     D0   01                          
39 01 00 00 00 00 02     D1   01                          
39 01 00 00 00 00 02     D2   10                          
39 01 00 00 00 00 02     D3   00                          
39 01 00 00 00 00 02     D4   00                          
39 01 00 00 00 00 02     D5   00                          
39 01 00 00 00 00 02     D6   00                          
39 01 00 00 00 00 02     D7   00                          
39 01 00 00 00 00 02     D8   00                          
39 01 00 00 00 00 02     D9   00                          
39 01 00 00 00 00 02     DA   00                          
39 01 00 00 00 00 02     DB   47                          
39 01 00 00 00 00 02     DC   02                          
39 01 00 00 00 00 02     DD   55                          
39 01 00 00 00 00 02     96   80                          
39 01 00 00 00 00 02     97   33                          
39 01 00 00 00 00 02     A0   10                          
39 01 00 00 00 00 02     A1   00                          
39 01 00 00 00 00 02     A2   08                          
39 01 00 00 00 00 02     A3   1E                          
39 01 00 00 00 00 02     A7   00                          
39 01 00 00 00 00 02     A6   32                          
39 01 00 00 00 00 02     A7   03                          
39 01 00 00 00 00 02     AE   14                          
39 01 00 00 00 00 02     E5   80                          
39 01 00 00 00 00 02     B2   04                          
39 01 00 00 00 00 02     B3   04                          
39 01 00 00 00 00 04     FF   78  07  02
39 01 00 00 00 00 02     00   00               
39 01 00 00 00 00 02     01   19               
39 01 00 00 00 00 02     02   00               
39 01 00 00 00 00 02     03   38               
39 01 00 00 00 00 02     04   00               
39 01 00 00 00 00 02     05   69               
39 01 00 00 00 00 02     06   00               
39 01 00 00 00 00 02     07   8C               
39 01 00 00 00 00 02     08   00               
39 01 00 00 00 00 02     09   A9               
39 01 00 00 00 00 02     0A   00               
39 01 00 00 00 00 02     0B   C1               
39 01 00 00 00 00 02     0C   00               
39 01 00 00 00 00 02     0D   D5               
39 01 00 00 00 00 02     0E   00               
39 01 00 00 00 00 02     0F   E8               
39 01 00 00 00 00 02     10   00               
39 01 00 00 00 00 02     11   F8               
39 01 00 00 00 00 02     12   01               
39 01 00 00 00 00 02     13   2C               
39 01 00 00 00 00 02     14   01               
39 01 00 00 00 00 02     15   52               
39 01 00 00 00 00 02     16   01               
39 01 00 00 00 00 02     17   8A               
39 01 00 00 00 00 02     18   01               
39 01 00 00 00 00 02     19   B4               
39 01 00 00 00 00 02     1A   01               
39 01 00 00 00 00 02     1B   F1               
39 01 00 00 00 00 02     1C   02               
39 01 00 00 00 00 02     1D   21               
39 01 00 00 00 00 02     1E   02               
39 01 00 00 00 00 02     1F   23               
39 01 00 00 00 00 02     20   02               
39 01 00 00 00 00 02     21   51               
39 01 00 00 00 00 02     22   02               
39 01 00 00 00 00 02     23   8A               
39 01 00 00 00 00 02     24   02               
39 01 00 00 00 00 02     25   B2               
39 01 00 00 00 00 02     26   02               
39 01 00 00 00 00 02     27   E9               
39 01 00 00 00 00 02     28   03               
39 01 00 00 00 00 02     29   0D               
39 01 00 00 00 00 02     2A   03               
39 01 00 00 00 00 02     2B   3A               
39 01 00 00 00 00 02     2C   03               
39 01 00 00 00 00 02     2D   47               
39 01 00 00 00 00 02     2E   03               
39 01 00 00 00 00 02     2F   56               
39 01 00 00 00 00 02     30   03               
39 01 00 00 00 00 02     31   67               
39 01 00 00 00 00 02     32   03               
39 01 00 00 00 00 02     33   7A               
39 01 00 00 00 00 02     34   03               
39 01 00 00 00 00 02     35   91               
39 01 00 00 00 00 02     36   03               
39 01 00 00 00 00 02     37   AC               
39 01 00 00 00 00 02     38   03               
39 01 00 00 00 00 02     39   C8               
39 01 00 00 00 00 02     3A   03               
39 01 00 00 00 00 02     3B   C1               
39 01 00 00 00 00 02     3C   00               
39 01 00 00 00 00 02     3D   11               
39 01 00 00 00 00 02     3E   00               
39 01 00 00 00 00 02     3F   38               
39 01 00 00 00 00 02     40   00               
39 01 00 00 00 00 02     41   69               
39 01 00 00 00 00 02     42   00               
39 01 00 00 00 00 02     43   8C               
39 01 00 00 00 00 02     44   00               
39 01 00 00 00 00 02     45   A9               
39 01 00 00 00 00 02     46   00               
39 01 00 00 00 00 02     47   C1               
39 01 00 00 00 00 02     48   00               
39 01 00 00 00 00 02     49   D5               
39 01 00 00 00 00 02     4A   00               
39 01 00 00 00 00 02     4B   E8               
39 01 00 00 00 00 02     4C   00               
39 01 00 00 00 00 02     4D   F8               
39 01 00 00 00 00 02     4E   01               
39 01 00 00 00 00 02     4F   2C               
39 01 00 00 00 00 02     50   01               
39 01 00 00 00 00 02     51   52               
39 01 00 00 00 00 02     52   01               
39 01 00 00 00 00 02     53   8A               
39 01 00 00 00 00 02     54   01               
39 01 00 00 00 00 02     55   B4               
39 01 00 00 00 00 02     56   01               
39 01 00 00 00 00 02     57   F1               
39 01 00 00 00 00 02     58   02               
39 01 00 00 00 00 02     59   21               
39 01 00 00 00 00 02     5A   02               
39 01 00 00 00 00 02     5B   23               
39 01 00 00 00 00 02     5C   02               
39 01 00 00 00 00 02     5D   51               
39 01 00 00 00 00 02     5E   02               
39 01 00 00 00 00 02     5F   8A               
39 01 00 00 00 00 02     60   02               
39 01 00 00 00 00 02     61   B2               
39 01 00 00 00 00 02     62   02               
39 01 00 00 00 00 02     63   E9               
39 01 00 00 00 00 02     64   03               
39 01 00 00 00 00 02     65   0D               
39 01 00 00 00 00 02     66   03               
39 01 00 00 00 00 02     67   3A               
39 01 00 00 00 00 02     68   03               
39 01 00 00 00 00 02     69   47               
39 01 00 00 00 00 02     6A   03               
39 01 00 00 00 00 02     6B   56               
39 01 00 00 00 00 02     6C   03               
39 01 00 00 00 00 02     6D   67               
39 01 00 00 00 00 02     6E   03               
39 01 00 00 00 00 02     6F   7A               
39 01 00 00 00 00 02     70   03               
39 01 00 00 00 00 02     71   91               
39 01 00 00 00 00 02     72   03               
39 01 00 00 00 00 02     73   AC               
39 01 00 00 00 00 02     74   03               
39 01 00 00 00 00 02     75   C8               
39 01 00 00 00 00 02     76   03               
39 01 00 00 00 00 02     77   EB               
39 01 00 00 00 00 02     78   01               
39 01 00 00 00 00 02     79   01               
39 01 00 00 00 00 04     FF   78 07 03
39 01 00 00 00 00 02     00   00        
39 01 00 00 00 00 02     01   19        
39 01 00 00 00 00 02     02   00        
39 01 00 00 00 00 02     03   39        
39 01 00 00 00 00 02     04   00        
39 01 00 00 00 00 02     05   6C        
39 01 00 00 00 00 02     06   00        
39 01 00 00 00 00 02     07   90        
39 01 00 00 00 00 02     08   00        
39 01 00 00 00 00 02     09   AC        
39 01 00 00 00 00 02     0A   00        
39 01 00 00 00 00 02     0B   C4        
39 01 00 00 00 00 02     0C   00        
39 01 00 00 00 00 02     0D   D8        
39 01 00 00 00 00 02     0E   00        
39 01 00 00 00 00 02     0F   EA        
39 01 00 00 00 00 02     10   00        
39 01 00 00 00 00 02     11   FA        
39 01 00 00 00 00 02     12   01        
39 01 00 00 00 00 02     13   2D        
39 01 00 00 00 00 02     14   01        
39 01 00 00 00 00 02     15   53        
39 01 00 00 00 00 02     16   01        
39 01 00 00 00 00 02     17   8B        
39 01 00 00 00 00 02     18   01        
39 01 00 00 00 00 02     19   B5        
39 01 00 00 00 00 02     1A   01        
39 01 00 00 00 00 02     1B   F2        
39 01 00 00 00 00 02     1C   02        
39 01 00 00 00 00 02     1D   22        
39 01 00 00 00 00 02     1E   02        
39 01 00 00 00 00 02     1F   23        
39 01 00 00 00 00 02     20   02        
39 01 00 00 00 00 02     21   51        
39 01 00 00 00 00 02     22   02        
39 01 00 00 00 00 02     23   8B        
39 01 00 00 00 00 02     24   02        
39 01 00 00 00 00 02     25   B3        
39 01 00 00 00 00 02     26   02        
39 01 00 00 00 00 02     27   EA        
39 01 00 00 00 00 02     28   03        
39 01 00 00 00 00 02     29   0E        
39 01 00 00 00 00 02     2A   03        
39 01 00 00 00 00 02     2B   3C        
39 01 00 00 00 00 02     2C   03        
39 01 00 00 00 00 02     2D   4A        
39 01 00 00 00 00 02     2E   03        
39 01 00 00 00 00 02     2F   59        
39 01 00 00 00 00 02     30   03        
39 01 00 00 00 00 02     31   6A        
39 01 00 00 00 00 02     32   03        
39 01 00 00 00 00 02     33   7E        
39 01 00 00 00 00 02     34   03        
39 01 00 00 00 00 02     35   94        
39 01 00 00 00 00 02     36   03        
39 01 00 00 00 00 02     37   AE        
39 01 00 00 00 00 02     38   03        
39 01 00 00 00 00 02     39   C9        
39 01 00 00 00 00 02     3A   03        
39 01 00 00 00 00 02     3B   C1        
39 01 00 00 00 00 02     3C   00        
39 01 00 00 00 00 02     3D   11        
39 01 00 00 00 00 02     3E   00        
39 01 00 00 00 00 02     3F   39        
39 01 00 00 00 00 02     40   00        
39 01 00 00 00 00 02     41   6C        
39 01 00 00 00 00 02     42   00        
39 01 00 00 00 00 02     43   90        
39 01 00 00 00 00 02     44   00        
39 01 00 00 00 00 02     45   AC        
39 01 00 00 00 00 02     46   00        
39 01 00 00 00 00 02     47   C4        
39 01 00 00 00 00 02     48   00        
39 01 00 00 00 00 02     49   D8        
39 01 00 00 00 00 02     4A   00        
39 01 00 00 00 00 02     4B   EA        
39 01 00 00 00 00 02     4C   00        
39 01 00 00 00 00 02     4D   FA        
39 01 00 00 00 00 02     4E   01        
39 01 00 00 00 00 02     4F   2D        
39 01 00 00 00 00 02     50   01        
39 01 00 00 00 00 02     51   53        
39 01 00 00 00 00 02     52   01        
39 01 00 00 00 00 02     53   8B        
39 01 00 00 00 00 02     54   01        
39 01 00 00 00 00 02     55   B5        
39 01 00 00 00 00 02     56   01        
39 01 00 00 00 00 02     57   F2        
39 01 00 00 00 00 02     58   02        
39 01 00 00 00 00 02     59   22        
39 01 00 00 00 00 02     5A   02        
39 01 00 00 00 00 02     5B   23        
39 01 00 00 00 00 02     5C   02        
39 01 00 00 00 00 02     5D   51        
39 01 00 00 00 00 02     5E   02        
39 01 00 00 00 00 02     5F   8B        
39 01 00 00 00 00 02     60   02        
39 01 00 00 00 00 02     61   B3        
39 01 00 00 00 00 02     62   02        
39 01 00 00 00 00 02     63   EA        
39 01 00 00 00 00 02     64   03        
39 01 00 00 00 00 02     65   0E        
39 01 00 00 00 00 02     66   03        
39 01 00 00 00 00 02     67   3C        
39 01 00 00 00 00 02     68   03        
39 01 00 00 00 00 02     69   4A        
39 01 00 00 00 00 02     6A   03        
39 01 00 00 00 00 02     6B   59        
39 01 00 00 00 00 02     6C   03        
39 01 00 00 00 00 02     6D   6A        
39 01 00 00 00 00 02     6E   03        
39 01 00 00 00 00 02     6F   7E        
39 01 00 00 00 00 02     70   03        
39 01 00 00 00 00 02     71   94        
39 01 00 00 00 00 02     72   03        
39 01 00 00 00 00 02     73   AE        
39 01 00 00 00 00 02     74   03        
39 01 00 00 00 00 02     75   C9        
39 01 00 00 00 00 02     76   03        
39 01 00 00 00 00 02     77   EB        
39 01 00 00 00 00 02     78   01
39 01 00 00 00 00 02     79   01
39 01 00 00 00 00 04     FF   78 07 04
39 01 00 00 00 00 02     00   00              
39 01 00 00 00 00 02     01   19              
39 01 00 00 00 00 02     02   00              
39 01 00 00 00 00 02     03   4D              
39 01 00 00 00 00 02     04   00              
39 01 00 00 00 00 02     05   86              
39 01 00 00 00 00 02     06   00              
39 01 00 00 00 00 02     07   AB              
39 01 00 00 00 00 02     08   00              
39 01 00 00 00 00 02     09   C7              
39 01 00 00 00 00 02     0A   00              
39 01 00 00 00 00 02     0B   DD              
39 01 00 00 00 00 02     0C   00              
39 01 00 00 00 00 02     0D   F0              
39 01 00 00 00 00 02     0E   01              
39 01 00 00 00 00 02     0F   01              
39 01 00 00 00 00 02     10   01              
39 01 00 00 00 00 02     11   10              
39 01 00 00 00 00 02     12   01              
39 01 00 00 00 00 02     13   40              
39 01 00 00 00 00 02     14   01              
39 01 00 00 00 00 02     15   63              
39 01 00 00 00 00 02     16   01              
39 01 00 00 00 00 02     17   96              
39 01 00 00 00 00 02     18   01              
39 01 00 00 00 00 02     19   BD              
39 01 00 00 00 00 02     1A   01              
39 01 00 00 00 00 02     1B   F7              
39 01 00 00 00 00 02     1C   02              
39 01 00 00 00 00 02     1D   25              
39 01 00 00 00 00 02     1E   02              
39 01 00 00 00 00 02     1F   26              
39 01 00 00 00 00 02     20   02              
39 01 00 00 00 00 02     21   54              
39 01 00 00 00 00 02     22   02              
39 01 00 00 00 00 02     23   8D              
39 01 00 00 00 00 02     24   02              
39 01 00 00 00 00 02     25   B5              
39 01 00 00 00 00 02     26   02              
39 01 00 00 00 00 02     27   ED              
39 01 00 00 00 00 02     28   03              
39 01 00 00 00 00 02     29   14              
39 01 00 00 00 00 02     2A   03              
39 01 00 00 00 00 02     2B   48              
39 01 00 00 00 00 02     2C   03              
39 01 00 00 00 00 02     2D   59              
39 01 00 00 00 00 02     2E   03              
39 01 00 00 00 00 02     2F   6B              
39 01 00 00 00 00 02     30   03              
39 01 00 00 00 00 02     31   7A              
39 01 00 00 00 00 02     32   03              
39 01 00 00 00 00 02     33   8B              
39 01 00 00 00 00 02     34   03              
39 01 00 00 00 00 02     35   9E              
39 01 00 00 00 00 02     36   03              
39 01 00 00 00 00 02     37   B6              
39 01 00 00 00 00 02     38   03              
39 01 00 00 00 00 02     39   CB              
39 01 00 00 00 00 02     3A   03              
39 01 00 00 00 00 02     3B   C1              
39 01 00 00 00 00 02     3C   00              
39 01 00 00 00 00 02     3D   11              
39 01 00 00 00 00 02     3E   00              
39 01 00 00 00 00 02     3F   4D              
39 01 00 00 00 00 02     40   00              
39 01 00 00 00 00 02     41   86              
39 01 00 00 00 00 02     42   00              
39 01 00 00 00 00 02     43   AB              
39 01 00 00 00 00 02     44   00              
39 01 00 00 00 00 02     45   C7              
39 01 00 00 00 00 02     46   00              
39 01 00 00 00 00 02     47   DD              
39 01 00 00 00 00 02     48   00              
39 01 00 00 00 00 02     49   F0              
39 01 00 00 00 00 02     4A   01              
39 01 00 00 00 00 02     4B   01              
39 01 00 00 00 00 02     4C   01              
39 01 00 00 00 00 02     4D   10              
39 01 00 00 00 00 02     4E   01              
39 01 00 00 00 00 02     4F   40              
39 01 00 00 00 00 02     50   01              
39 01 00 00 00 00 02     51   63              
39 01 00 00 00 00 02     52   01              
39 01 00 00 00 00 02     53   96              
39 01 00 00 00 00 02     54   01              
39 01 00 00 00 00 02     55   BD              
39 01 00 00 00 00 02     56   01              
39 01 00 00 00 00 02     57   F7              
39 01 00 00 00 00 02     58   02              
39 01 00 00 00 00 02     59   25              
39 01 00 00 00 00 02     5A   02              
39 01 00 00 00 00 02     5B   26              
39 01 00 00 00 00 02     5C   02              
39 01 00 00 00 00 02     5D   54              
39 01 00 00 00 00 02     5E   02              
39 01 00 00 00 00 02     5F   8D              
39 01 00 00 00 00 02     60   02              
39 01 00 00 00 00 02     61   B5              
39 01 00 00 00 00 02     62   02              
39 01 00 00 00 00 02     63   ED              
39 01 00 00 00 00 02     64   03              
39 01 00 00 00 00 02     65   14              
39 01 00 00 00 00 02     66   03              
39 01 00 00 00 00 02     67   48              
39 01 00 00 00 00 02     68   03              
39 01 00 00 00 00 02     69   59              
39 01 00 00 00 00 02     6A   03              
39 01 00 00 00 00 02     6B   6B              
39 01 00 00 00 00 02     6C   03              
39 01 00 00 00 00 02     6D   7A              
39 01 00 00 00 00 02     6E   03              
39 01 00 00 00 00 02     6F   8B              
39 01 00 00 00 00 02     70   03              
39 01 00 00 00 00 02     71   9E              
39 01 00 00 00 00 02     72   03              
39 01 00 00 00 00 02     73   B6              
39 01 00 00 00 00 02     74   03              
39 01 00 00 00 00 02     75   CB              
39 01 00 00 00 00 02     76   03              
39 01 00 00 00 00 02     77   EB              
39 01 00 00 00 00 02     78   01              
39 01 00 00 00 00 02     79   01
39 01 00 00 0f 00 04     FF   78 07 00
05 01 00 00 c8 00 02 11 00
05 01 00 00 0f 00 02 29 00
05 01 00 00 0f 00 02 35 00
                                ];
        qcom,mdss-dsi-off-command = [05 01 00 00 00 00 02 28 00
                                05 01 00 00 00 00 02 10 00];


		qcom,mdss-dsi-on-command-state = "dsi_lp_mode";
		qcom,mdss-dsi-off-command-state = "dsi_lp_mode";
		qcom,mdss-dsi-reset-sequence = <1 50>, <0 120>, <1 50>;
		qcom,mdss-dsi-tx-eot-append;
		qcom,mdss-dsi-post-init-delay = <1>;

	    qcom,mdss-dsi-force-clock-lane-hs;
        qcom,mdss-dsi-always-on;
	    qcom,mdss-dsi-lp11-init;
        qcom,mdss-dsi-bl-pmic-pwm-frequency = <30>;
        qcom,mdss-dsi-bl-pmic-bank-select = <0>;
        qcom,mdss-dsi-pwm-gpio = <&pm8953_mpps 3 0>;
        qcom,mdss-dsi-bl-pmic-control-type = "bl_ctrl_pwm";

	qcom,mdss-dsi-panel-destination = "display_1";

	};
};

/* Copyright (c) 2015-2016, The Linux Foundation. All rights reserved.
 *
 * This program is free software; you can redistribute it and/or modify
 * it under the terms of the GNU General Public License version 2 and
 * only version 2 as published by the Free Software Foundation.
 *
 * This program is distributed in the hope that it will be useful,
 * but WITHOUT ANY WARRANTY; without even the implied warranty of
 * MERCHANTABILITY or FITNESS FOR A PARTICULAR PURPOSE.  See the
 * GNU General Public License for more details.
 */
&mdss_mdp {
        dsi_truly_1080_vid: qcom,mdss_dsi_truly_1080p_video {
                qcom,mdss-dsi-panel-name = "wo yaofl truly 1080p video mode dsi panel riLCD-bl";
		qcom,mdss-dsi-panel-type = "dsi_video_mode";
		qcom,mdss-dsi-panel-framerate = <57>;
		qcom,mdss-dsi-virtual-channel-id = <0>;
		qcom,mdss-dsi-stream = <0>;
		/***qcom,mdss-dsi-panel-width = <1080>;
		qcom,mdss-dsi-panel-height = <1920>;
		qcom,mdss-dsi-h-front-porch = <96>;
		qcom,mdss-dsi-h-back-porch = <64>;
		qcom,mdss-dsi-h-pulse-width = <16>;
		qcom,mdss-dsi-h-sync-skew = <0>;
		qcom,mdss-dsi-v-back-porch = <16>;
		qcom,mdss-dsi-v-front-porch = <4>;
		qcom,mdss-dsi-v-pulse-width = <1>;
		qcom,mdss-dsi-h-left-border = <0>;
		qcom,mdss-dsi-h-right-border = <0>;
		qcom,mdss-dsi-v-top-border = <0>;
		qcom,mdss-dsi-v-bottom-border = <0>;*/
  qcom,mdss-dsi-panel-width = <720>;
                qcom,mdss-dsi-panel-height = <1280>;
/**from lk*/
               qcom,mdss-dsi-h-front-porch = <52>;
                qcom,mdss-dsi-h-back-porch = <100>;
                qcom,mdss-dsi-h-pulse-width = <24>;
                qcom,mdss-dsi-h-sync-skew = <0>;
                qcom,mdss-dsi-v-back-porch = <40>;
                qcom,mdss-dsi-v-front-porch = <8>;
                qcom,mdss-dsi-v-pulse-width = <4>;
/*  qcom,mdss-dsi-h-front-porch = <100>;
                qcom,mdss-dsi-h-back-porch = <100>;
                qcom,mdss-dsi-h-pulse-width = <6>;
                qcom,mdss-dsi-h-sync-skew = <0>;
                qcom,mdss-dsi-v-back-porch = <32>;
                qcom,mdss-dsi-v-front-porch = <32>;
                qcom,mdss-dsi-v-pulse-width = <2>;
*/
                qcom,mdss-dsi-h-left-border = <0>;
                qcom,mdss-dsi-h-right-border = <0>;
                qcom,mdss-dsi-v-top-border = <0>;
                qcom,mdss-dsi-v-bottom-border = <0>;

		qcom,mdss-dsi-bpp = <24>;
		qcom,mdss-dsi-underflow-color = <0xff>;
		qcom,mdss-dsi-border-color = <0>;
		qcom,mdss-dsi-h-sync-pulse = <0>;
		qcom,mdss-dsi-traffic-mode = "burst_mode";
		qcom,mdss-dsi-bllp-eof-power-mode;
		qcom,mdss-dsi-bllp-power-mode;
		qcom,mdss-dsi-lane-0-state;
		qcom,mdss-dsi-lane-1-state;
		qcom,mdss-dsi-lane-2-state;
		qcom,mdss-dsi-lane-3-state;
		/*qcom,mdss-dsi-panel-timings = [79 1a 12 00 3e 42 16 1e 15 03 04 00];*/
               /* qcom,mdss-dsi-panel-timings = [1e 0d 04 05 02 1e 1b 04 06 02 03 04];*/
              /* qcom,mdss-dsi-panel-timings = [79 1e 0d 04 05 02 1e 1b 04 06 02 03];
			qcom,mdss-dsi-t-clk-post = <0x04>;
                qcom,mdss-dsi-t-clk-pre = <0x1b>;*/
    qcom,mdss-dsi-panel-timings = [79 1a 12 00 3e 42 16 1e 15 03 04 00];
                qcom,mdss-dsi-t-clk-post = <0x04>;
                qcom,mdss-dsi-t-clk-pre = <0x1b>;
/*
   qcom,mdss-dsi-panel-timings = [87 2c 12 00 40 44 16 1e 17 03
                        04 00];
                qcom,mdss-dsi-t-clk-post = <0x0A>;
                qcom,mdss-dsi-t-clk-pre = <0x1d>;*/

		qcom,mdss-dsi-bl-min-level = <1>;
	        qcom,mdss-dsi-bl-max-level = <4095>;

		qcom,mdss-dsi-dma-trigger = "trigger_sw";
		qcom,mdss-dsi-mdp-trigger = "none";
	/*	qcom,mdss-dsi-on-command = [15 01 00 00 00 00 02 35 00
			15 01 00 00 00 00 02 51 ff
			15 01 00 00 00 00 02 53 2c
			15 01 00 00 00 00 02 55 00
			05 01 00 00 78 00 02 11 00
			23 01 00 00 00 00 02 b0 00
			29 01 00 00 00 00 07 b3 14 00 00 00 00 00
			29 01 00 00 00 00 03 b6 3a d3
			29 01 00 00 00 00 03 c0 00 00
			29 01 00 00 00 00 23 c1 84 60 10 eb ff 6f ce ff ff 17 02
				58 73 ae b1 20 c6 ff ff 1f f3 ff 5f 10 10 10 10 00 02 01
				22 22 00 01
			29 01 00 00 00 00 08 c2 31 f7 80 06 08 00 00
			29 01 00 00 00 00 17 c4 70 00 00 00 00 04 00 00 00 0c 06
				00 00 00 00 00 04 00 00 00 0c 06
			29 01 00 00 00 00 29 c6 00 69 00 69 00 69 00 00 00 00 00
				69 00 69 00 69 10 19 07 00 01 00 69 00 69 00 69 00 00 00
				00 00 69 00 69 00 69 10 19 07
			29 01 00 00 00 00 0a cb 31 fc 3f 8c 00 00 00 00 c0
			23 01 00 00 00 00 02 cc 0b
			29 01 00 00 00 00 0b d0 11 81 bb 1e 1e 4c 19 19 0c 00
			29 01 00 00 00 00 1a d3 1b 33 bb bb b3 33 33 33 00 01 00
				a0 d8 a0 0d 4e 4e 33 3b 22 72 07 3d bf 33
			29 01 00 00 00 00 08 d5 06 00 00 01 51 01 32
			29 01 00 00 00 00 1f c7 01 0a 11 18 26 33 3e 50 38 42 52
				60 67 6e 77 01 0a 11 18 26 33 3e 50 38 42 52 60 67 6e 77
			29 01 00 00 14 00 14 c8 01 00 00 00 00 fc 00 00 00 00
				00 fc 00 00 00 00 00 fc 00
			05 01 00 00 14 00 02 29 00];
		qcom,mdss-dsi-off-command = [05 01 00 00 14 00 02 28 00
				 05 01 00 00 78 00 02 10 00];
*/


 qcom,mdss-dsi-on-command = [
                                39 01 00 00 00 00 04 B9 FF 83 94
                                39 01 00 00 00 00 07 BA 63 03 68 6B B2 C0
                                39 01 00 00 00 00 0B B1 48 12 72 09 32 44 71 31 4F 35
                                39 01 00 00 00 00 06 B2 00 80 64 05 07
                                39 01 00 00 00 00 1f B4 26 76 26 76 26 26 05 10 86 35 00 3F 26 76 26 76 26 26 05 10 86 3F 00 FF 81 81 81 81 08 01
                                39 01 00 00 00 00 22 D3 00 00 0F 0F 01 01 10 10 32 10 00 00 00 32 15 04 05 04 32 15 14 05 14 37 33 04 04 37 00 00 47 05 40
                                39 01 00 00 00 00 2d D5 18 18 25 24 27 26 11 10 15 14 13 12 17 16 01 00 18 18 18 18 18 18 18 18 18 18 05 04 03 02 07 06 18 18 18 18 21 20 23 22 18 18 18 18
                                39 01 00 00 00 00 2d D6 18 18 22 23 20 21 12 13 16 17 10 11 14 15 06 07 18 18 18 18 18 18 18 18 18 18 02 03 04 05 00 01 18 18 18 18 26 27 24 25 18 18 18 18
                                39 01 00 00 00 00 3b E0 00 03 0B 0E 10 13 17 15 2D 3D 51 51 5E 75 7C 84 94 9A 98 A6 B2 57 57 5A 60 64 6A 72 7F 00 03 0B 0E 10 13 17 15 2D 3D 51 51 5E 75 7C 84 94 9A 98 A6 B2 57 57 5A 60 64 6A 72 7F
                                39 01 00 00 00 00 03 B6 4E 4E
                                39 01 00 00 00 00 02 CC 0B
                                39 01 00 00 00 00 03 C0 1F 31
                                39 01 00 00 00 00 02 D2 88
                                39 01 00 00 00 00 02 D4 02
                                39 01 00 00 00 00 02 BD 01
                                39 01 00 00 00 00 02 B1 60
                                39 01 00 00 00 00 02 BD 00
                                39 01 00 00 00 00 08 BF 40 81 50 00 1A FC 01
                                05 01 00 00 c8 00 02 11 00
                                05 01 00 00 0a 00 02 29 00
                                ];
                qcom,mdss-dsi-off-command = [05 01 00 00 00 00 02 28 00
                                05 01 00 00 00 00 02 10 00];


		qcom,mdss-dsi-on-command-state = "dsi_lp_mode";
		qcom,mdss-dsi-off-command-state = "dsi_lp_mode";
	/*	qcom,mdss-dsi-bl-pmic-control-type = "bl_ctrl_wled"; */
		qcom,mdss-dsi-reset-sequence = <1 10>, <0 10>, <1 10>;
		qcom,mdss-dsi-tx-eot-append;
		qcom,mdss-dsi-post-init-delay = <1>;

	qcom,mdss-dsi-force-clock-lane-hs;
                qcom,mdss-dsi-always-on;
	 qcom,mdss-dsi-lp11-init;
	 /* qcom,cont-splash-enabled;*/

  /*	pwms = <&pm8953_pwm 0 0>;
        pwm-names = "backlight";*/
        /*qcom,mdss-dsi-bl-pwm-pmi;*/
        qcom,mdss-dsi-bl-pmic-pwm-frequency = <30>;
	 qcom,mdss-dsi-bl-pmic-bank-select = <0>;
         qcom,mdss-dsi-pwm-gpio = <&pm8953_mpps 3 0>;
                qcom,mdss-dsi-bl-pmic-control-type = "bl_ctrl_pwm";

	qcom,mdss-dsi-panel-destination = "display_1";

	};
};
